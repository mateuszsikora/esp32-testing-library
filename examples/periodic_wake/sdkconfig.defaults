## firmware/mqtt_session/sdkconfig.defaults
```kconfig
CONFIG_ESPTOOLPY_FLASHSIZE_4MB=y
CONFIG_LWIP_PPP_SUPPORT=y
CONFIG_LWIP_PPP_NOTIFY_PHASE_SUPPORT=y
CONFIG_LWIP_PPP_PAP_SUPPORT=y
CONFIG_LWIP_TCPIP_TASK_STACK_SIZE=4096
# CONFIG_LWIP_PPP_ENABLE_IPV6 is not set
```

## tools/hci_probe/sdkconfig.defaults
```kconfig
CONFIG_BT_ENABLED=y
CONFIG_BT_BLE_50_FEATURES_SUPPORTED=n
CONFIG_BT_BLE_42_FEATURES_SUPPORTED=y
CONFIG_ESP_CONSOLE_USB_SERIAL_JTAG=y
CONFIG_ESP_CONSOLE_SECONDARY_NONE=y
```

## tools/sleep_reset_probe/main/Kconfig.projbuild
```kconfig
config PROBE_RESET_RTC
    bool "Reset the RTC domain as well as the digital system"
    default n
    help
        Select the RTC watchdog's RESET_RTC stage action instead of RESET_SYSTEM.
```
